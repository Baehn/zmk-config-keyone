## config/boards/shields/keyone/Kconfig.defconfig
```kconfig
if SHIELD_KEYONE_LEFT

config ZMK_KEYBOARD_NAME
	default "keyone"

config ZMK_SPLIT_BLE_ROLE_CENTRAL
	default y

endif

if SHIELD_KEYONE_LEFT || SHIELD_KEYONE_RIGHT

config ZMK_SPLIT
	default y

endif
```

## config/boards/shields/keyone/Kconfig.shield
```kconfig
config SHIELD_KEYONE_LEFT
  def_bool $(shields_list_contains, keyone_left)

config SHIELD_KEYONE_RIGHT
  def_bool $(shields_list_contains, keyone_right)
```
